## toolchain/binutils/Config.in
```kconfig
# Choose binutils version.

choice
	prompt "Binutils Version" if TOOLCHAINOPTS
	default BINUTILS_USE_VERSION_2_42
	help
	  Select the version of binutils you wish to use.

	config BINUTILS_USE_VERSION_2_40
		bool "Binutils 2.40"
		select BINUTILS_VERSION_2_40

	config BINUTILS_USE_VERSION_2_41
		bool "Binutils 2.41"
		select BINUTILS_VERSION_2_41

	config BINUTILS_USE_VERSION_2_42
		bool "Binutils 2.42"
		select BINUTILS_VERSION_2_42
endchoice

config EXTRA_BINUTILS_CONFIG_OPTIONS
	string
	prompt "Additional binutils configure options" if TOOLCHAINOPTS
	default ""
	help
	    Any additional binutils options you may want to include....
```
